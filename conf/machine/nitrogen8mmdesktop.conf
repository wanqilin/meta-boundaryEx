## conf/machine/nitrogen8mmdesktop.conf
```bitbake
MACHINE="nitrogen8mm"
require conf/machine/nitrogen8mm.conf

require conf/machine/include/ubuntubasics.inc
```

## conf/machine/nitrogen8mpdesktop.conf
```bitbake
MACHINE="nitrogen8mp"
require conf/machine/nitrogen8mp.conf

require conf/machine/include/ubuntubasics.inc
```
